## ksrc/drivers/testing/Kconfig
```kconfig
menu "Testing drivers"

config XENO_DRIVERS_TIMERBENCH
	depends on XENO_SKIN_RTDM && XENO_OPT_NUCLEUS
	tristate "Timer benchmark driver"
	help
	Kernel-based benchmark driver for timer latency evaluation.
	See testsuite/latency for a possible front-end.

config XENO_DRIVERS_IRQBENCH
	depends on XENO_SKIN_RTDM
	tristate "IRQ benchmark driver"
	help
	Loopback driver for IRQ latency evaluation over serial or parallel
	port links. Additionally requires user-space helper and a logging tool
	(see testsuite/irqbench).

config XENO_DRIVERS_SWITCHTEST
	depends on XENO_SKIN_RTDM && XENO_OPT_NUCLEUS
	tristate "Context switch unit testing driver"
	help
	Kernel-based driver for unit testing context switches and
	FPU switches.

config XENO_DRIVERS_RTDMTEST
	depends on XENO_SKIN_RTDM
	tristate "RTDM API testing driver"
	help
	Kernel-based driver for testing the basic functionality of the
	RTDM API. It's intened for testing the RTDM over Linux-rt port.

endmenu
```

## ksrc/skins/rtdm/native/Kconfig
```kconfig
menu "Real-time sub-system"

config XENO_SKIN_RTDM
	tristate "Real-Time Driver Model"
	default y
	help

	This API skin allows to write real-time drivers against a common
	light weight interface in kernel mode, but use them across all other
	skins in both kernel and user mode.

config XENO_OPT_DEBUG_RTDM
	bool "RTDM debugging support"
	depends on XENO_SKIN_RTDM
	default y
	help

	This option activates debugging checks for the RTDM subsystem.
	It is a recommended option for analysing potential issues in RTDM
	drivers. A minor runtime overhead is added.

source "drivers/xenomai/Kconfig"

endmenu
```
